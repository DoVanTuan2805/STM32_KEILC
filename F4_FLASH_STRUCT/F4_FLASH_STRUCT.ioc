# file: F4_FLASH_STRUCT.ioc
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Mcu.Family=STM32F4
Mcu.Name=STM32F401C(B-C)Ux
Mcu.Package=UFQFPN48
NVIC.PriorityGroup=NVIC_PRIORITYGROUP_4
PA13.Mode=Serial_Wire
PA13.Signal=SYS_JTMS-SWDIO
PA14.Mode=Serial_Wire
PA14.Signal=SYS_JTCK-SWCLK
PC13-ANTI_TAMP.GPIO_Label=LED
PC13-ANTI_TAMP.Signal=GPIO_Output
PH0\ -\ OSC_IN.Mode=HSE-External-Oscillator
PH0\ -\ OSC_IN.Signal=RCC_OSC_IN
PH1\ -\ OSC_OUT.Mode=HSE-External-Oscillator
PH1\ -\ OSC_OUT.Signal=RCC_OSC_OUT
ProjectManager.HeapSize=0x200
ProjectManager.StackSize=0x400
ProjectManager.TargetToolchain=MDK-ARM V5.32
RCC.48MHZClocksFreq_Value=42000000
RCC.AHBFreq_Value=84000000
RCC.APB1CLKDivider=RCC_HCLK_DIV2
RCC.APB1Freq_Value=42000000
RCC.APB1TimFreq_Value=84000000
RCC.APB2Freq_Value=84000000
RCC.APB2TimFreq_Value=84000000
RCC.CortexFreq_Value=84000000
RCC.HCLKFreq_Value=84000000
RCC.HSE_VALUE=25000000
RCC.HSI_VALUE=16000000
RCC.LSE_VALUE=32768
RCC.PLLM=8
RCC.PLLN=84
RCC.SYSCLKFreq_VALUE=84000000
RCC.SYSCLKSource=RCC_SYSCLKSOURCE_PLLCLK
RCC.VCOOutputFreq_Value=168000000
board=custom

// file: Core/Src/main.c
/* USER CODE BEGIN Header */
/**
  ******************************************************************************
  * @file           : main.c
  * @brief          : Main program body
  ******************************************************************************
  * @attention
  *
  * Copyright (c) 2024 STMicroelectronics.
  * All rights reserved.
  *
  * This software is licensed under terms that can be found in the LICENSE file
  * in the root directory of this software component.
  * If no LICENSE file comes with this software, it is provided AS-IS.
  *
  ******************************************************************************
  */
/* USER CODE END Header */
#include "main.h"
#include "stdlib.h"
#include "gpio.h"
#include "Flash_user.h"
#include "string.h"

void SystemClock_Config(void);

/* USER CODE BEGIN 0 */
uint8_t sizeDataRead;

dataSaveFlash_t  dataRead;
dataSaveFlash_t dataWrite =
{
	.value = 10,
};

uint8_t dataReadFlash[5][5];

dataSaveFlash2_t dataWrite2, dataRead2;

#define ROWS 5
#define COLS 5

uint8_t **data;
uint8_t dataAfter[ROWS*COLS];

void convertArray(uint8_t **arr2D, uint8_t *arr1D, int rows, int cols)
{
	int i, j, k = 0;
    for (i = 0; i < rows; i++) {
        for (j = 0; j < cols; j++) {
            arr1D[k++] = arr2D[i][j];
        }
    }
}
/* USER CODE END 0 */

int main(void)
{

  /* MCU Configuration--------------------------------------------------------*/

  /* Reset of all peripherals, Initializes the Flash interface and the Systick. */
  HAL_Init();

  /* Configure the system clock */
  SystemClock_Config();

  /* Initialize all configured peripherals */
  MX_GPIO_Init();
  /* USER CODE BEGIN 2 */

//	HAL_Delay(100);
//	Flash_Write_Array(0x08010000, arrayWrite, sizeof(arrayWrite));
//	HAL_Delay(100);
//	Flash_Read_Array(0x08010000, arrayRead, sizeof(arrayRead));
	data = (uint8_t**)malloc(5 * sizeof(uint8_t*));

	for(int i = 0; i < 5; i++)		// rows
	{
		data[i] = (uint8_t*)malloc(5 * sizeof(uint8_t));
		if (data[i] == NULL)
		{
			for (int j = 0; j < i; j++)
			{
				free(data[j]);
			}
			free(data);
		}
		for(int k = 0 ; k < 5; k++)
		{
			data[i][k] = i+k;
		}
	}

	for(int i = 0; i < 5; i++)		// rows
	{
		for(int k = 0 ; k < 5; k++)
		{
			dataReadFlash[i][k] = data[i][k];
		}
	}

	dataWrite.data = (uint8_t*) malloc((ROWS * COLS) * sizeof(uint8_t));

	convertArray(data, dataWrite.data, ROWS, COLS);

	Flash_Write_Array(0x08040000, dataWrite.data, ROWS * COLS);
	//Flash_Write_Struct(0x08040000, dataWrite);
	HAL_Delay(50);
	dataRead.data = (uint8_t*) malloc((ROWS * COLS) * sizeof(uint8_t));
	Flash_Read_Array(0x08040000, dataRead.data, ROWS*COLS);

	memcpy(dataAfter , dataRead.data , sizeof(dataAfter));

  /* USER CODE END 2 */

  /* Infinite loop */
  while (1)
  {

  }
}

void SystemClock_Config(void)
{
  RCC_OscInitTypeDef RCC_OscInitStruct = {0};
  RCC_ClkInitTypeDef RCC_ClkInitStruct = {0};

  /** Configure the main internal regulator output voltage
  */
  __HAL_RCC_PWR_CLK_ENABLE();
  __HAL_PWR_VOLTAGESCALING_CONFIG(PWR_REGULATOR_VOLTAGE_SCALE2);

  /** Initializes the RCC Oscillators according to the specified parameters
  * in the RCC_OscInitTypeDef structure.
  */
  RCC_OscInitStruct.OscillatorType = RCC_OSCILLATORTYPE_HSI;
  RCC_OscInitStruct.HSIState = RCC_HSI_ON;
  RCC_OscInitStruct.HSICalibrationValue = RCC_HSICALIBRATION_DEFAULT;
  RCC_OscInitStruct.PLL.PLLState = RCC_PLL_ON;
  RCC_OscInitStruct.PLL.PLLSource = RCC_PLLSOURCE_HSI;
  RCC_OscInitStruct.PLL.PLLM = 8;
  RCC_OscInitStruct.PLL.PLLN = 84;
  RCC_OscInitStruct.PLL.PLLP = RCC_PLLP_DIV2;
  RCC_OscInitStruct.PLL.PLLQ = 4;
  if (HAL_RCC_OscConfig(&RCC_OscInitStruct) != HAL_OK)
  {
    Error_Handler();
  }

  /** Initializes the CPU, AHB and APB buses clocks
  */
  RCC_ClkInitStruct.ClockType = RCC_CLOCKTYPE_HCLK|RCC_CLOCKTYPE_SYSCLK
                              |RCC_CLOCKTYPE_PCLK1|RCC_CLOCKTYPE_PCLK2;
  RCC_ClkInitStruct.SYSCLKSource = RCC_SYSCLKSOURCE_PLLCLK;
  RCC_ClkInitStruct.AHBCLKDivider = RCC_SYSCLK_DIV1;
  RCC_ClkInitStruct.APB1CLKDivider = RCC_HCLK_DIV2;
  RCC_ClkInitStruct.APB2CLKDivider = RCC_HCLK_DIV1;

  if (HAL_RCC_ClockConfig(&RCC_ClkInitStruct, FLASH_LATENCY_2) != HAL_OK)
  {
    Error_Handler();
  }
}

void Error_Handler(void)
{
  __disable_irq();
  while (1)
  {
  }
}
